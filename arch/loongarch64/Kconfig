## arch/loongarch64/Kconfig
```kconfig
#
# Copyright (c) 2016 Jean-Paul Etienne <fractalclone@gmail.com>
#
# SPDX-License-Identifier: Apache-2.0
#

choice
	prompt "LOONGARCH64 configuration selection"
	depends on LOONGARCH64
	source "arch/loongarch64/soc/*/Kconfig.soc"
endchoice

menu "LOONGARCH64 Options"
	depends on LOONGARCH64

config ARCH
	string
	default "loongarch64"

config ARCH_DEFCONFIG
	string
	default "arch/loongarch64/defconfig"

menu "LOONGARCH64 Processor Options"

config INCLUDE_RESET_VECTOR
	bool "Include Reset vector"
	default n
	help
	Include the reset vector stub that inits CPU and then jumps to __start

config LOONGARCH_IRQ_OFFLOAD
	bool "Enable IRQ offload"
	default n
	help
	Enable irq_offload() API which allows functions to be synchronously
	run in interrupt context. Mainly useful for test cases.

config LOONGARCH_SOC_CONTEXT_SAVE
	bool "Enable SOC-based context saving in IRQ handler"
	default n
	help
	Enable SOC-based context saving, for SOCS which require saving of
	extra registers when entering an interrupt/exception

config LOONGARCH_SOC_INTERRUPT_INIT
	bool "Enable SOC-based interrupt initialization"
	default n
	help
	Enable SOC-based interrupt initialization
	(call soc_interrupt_init, within _IntLibInit when enabled)

config LOONGARCH_GENERIC_TOOLCHAIN
	bool "Compile using generic loongarch64 toolchain"
	default y
	help
	Compile using generic loongarch64 toolchain.
	Allow SOCs that have custom extended ISA to still
	compile with generic loongarch64 toolchain.

config LOONGARCH_HAS_CPU_IDLE
	bool "Does SOC has CPU IDLE instruction"
	default n
	help
	Does SOC has CPU IDLE instruction

config GEN_ISR_TABLES
	default y

config GEN_IRQ_VECTOR_TABLE
	default n

endmenu

source "arch/loongarch64/soc/*/Kconfig"

endmenu
```

## arch/loongarch64/soc/loongarch-privilege/Kconfig.defconfig
```kconfig
# Kconfig - LoongArch privilege-mode SoC family
# SPDX-License-Identifier: Apache-2.0

config SOC_FAMILY_LOONGARCH_PRIVILEGE
	bool
	default n

config SOC_FAMILY
	string
	default "loongarch-privilege"
	depends on SOC_FAMILY_LOONGARCH_PRIVILEGE

config LOONGARCH_HAS_PLIC
	bool "Does the SoC provide a Platform Level Interrupt Controller"
	default n
	depends on SOC_FAMILY_LOONGARCH_PRIVILEGE
	help
	  Does the SoC provide support for a Platform Level Interrupt Controller

source "arch/loongarch64/soc/loongarch-privilege/*/Kconfig.defconfig.series"
```

## arch/loongarch64/soc/loongarch-privilege/fe310/Kconfig.series
```kconfig
# Kconfig - LoongArch FE310 SoC implementation
# SPDX-License-Identifier: Apache-2.0

config SOC_SERIES_LOONGARCH_FE310
	bool "SiFive Freedom E310 SoC implementation (LoongArch port)"
	depends on LOONGARCH64
	select SOC_FAMILY_LOONGARCH_PRIVILEGE
	help
	  Enable support for SiFive Freedom E310 SoC (LoongArch port)
```

## arch/loongarch64/soc/loongarch-privilege/fe310/Kconfig.soc
```kconfig
# Kconfig - LoongArch FE310 SoC configuration options
# SPDX-License-Identifier: Apache-2.0

choice
prompt "SiFive Freedom E310 SoC implementation"
depends on SOC_SERIES_LOONGARCH_FE310

config SOC_LOONGARCH_FE310
	bool "SiFive Freedom E310 SoC implementation"
	select ATOMIC_OPERATIONS_C

endchoice
```

## arch/loongarch64/soc/loongarch-privilege/loongarch64-qemu/Kconfig.defconfig.series
```kconfig
if SOC_SERIES_LOONGARCH64_QEMU

config SOC_SERIES
	string
	default "loongarch64-qemu"

config SYS_CLOCK_HW_CYCLES_PER_SEC
	int
	default 10000000

config LOONGARCH_SOC_INTERRUPT_INIT
	bool
	default y

config INCLUDE_RESET_VECTOR
	bool
	default y

config NUM_IRQS
	int
	default 32

config LOONGARCH_ROM_BASE_ADDR
	hex
	default 0x00001000

config LOONGARCH_ROM_SIZE
	hex
	default 0x100000

config LOONGARCH_RAM_BASE_ADDR
	hex
	default 0x80000000

config LOONGARCH_RAM_SIZE_MB
	int
	default 32

endif # SOC_SERIES_LOONGARCH64_QEMU
```

## arch/loongarch64/soc/loongarch-privilege/loongarch64-qemu/Kconfig.series
```kconfig
# Kconfig - LoongArch64 QEMU SoC implementation
# SPDX-License-Identifier: Apache-2.0

config SOC_SERIES_LOONGARCH64_QEMU
	bool "LoongArch64 QEMU SoC implementation"
	depends on LOONGARCH64
	select SOC_FAMILY_LOONGARCH_PRIVILEGE
	help
	  Enable support for LoongArch64 QEMU SoC implementation
```

## arch/loongarch64/soc/loongarch-privilege/loongarch64-qemu/Kconfig.soc
```kconfig
# Kconfig - LoongArch64 QEMU SoC configuration options
# SPDX-License-Identifier: Apache-2.0

choice
prompt "LoongArch64 QEMU SoC implementation"
depends on SOC_SERIES_LOONGARCH64_QEMU

config SOC_LOONGARCH64_QEMU
	bool "LoongArch64 QEMU SoC implementation"
	select ATOMIC_OPERATIONS_C

endchoice
```

## arch/riscv32/soc/pulpino/Kconfig.soc
```kconfig
if RISCV32

config SOC_RISCV32_PULPINO
	bool "Pulpino SOC implementation"
	select ATOMIC_OPERATIONS_C

endif
```

## boards/loongarch64/qemu_loongarch64/Kconfig.board
```kconfig
config BOARD_QEMU_LOONGARCH64
    bool "QEMU LOONGARCH64 target"
    depends on SOC_LOONGARCH64_QEMU
```

## boards/loongarch64/qemu_loongarch64/qemu_loongarch64_defconfig
```kconfig
CONFIG_LOONGARCH64=y
CONFIG_SOC_SERIES_LOONGARCH64_QEMU=y
CONFIG_SOC_LOONGARCH64_QEMU=y
CONFIG_BOARD_QEMU_LOONGARCH64=y
CONFIG_CONSOLE=y
CONFIG_PRINTK=y
CONFIG_SERIAL=y
CONFIG_UART_RISCV_QEMU=y
CONFIG_UART_CONSOLE=y
CONFIG_UART_CONSOLE_ON_DEV_NAME="uart0"
CONFIG_RISCV_MACHINE_TIMER=y
CONFIG_BOOT_BANNER=y
```

## drivers/serial/Kconfig.loongarch_qemu
```kconfig
# Kconfig.loongarch_qemu - loongarch-qemu UART configuration option
#
# SPDX-License-Identifier: Apache-2.0

menuconfig UART_LOONGARCH_QEMU
	bool "loongarch-qemu UART driver"
	depends on SOC_LOONGARCH64_QEMU
	default y
	select SERIAL_HAS_DRIVER
	help
	Enable the LoongArch QEMU MMIO UART driver (polling).
```
